## drivers/input/touchscreen/Kconfig
```kconfig
#
# Touchscreen driver configuration
#
menuconfig INPUT_TOUCHSCREEN
	bool "Touchscreens"
	help
	  Say Y here, and a list of supported touchscreens will be displayed.
	  This option doesn't affect the kernel.

	  If unsure, say Y.

if INPUT_TOUCHSCREEN

config TOUCHSCREEN_PROPERTIES
	def_tristate INPUT
	depends on INPUT

config TOUCHSCREEN_DUMP_MODE
	bool "touchscreen dump mode"
	depends on I2C
	help
	  Say Y here if you need to get raw data.

	  If unsure, say N.

source "drivers/input/touchscreen/sec_ts/Kconfig"
source "drivers/input/touchscreen/sec_ts/y771/Kconfig"
endif
```
